## linux/Documentation/devicetree/bindings/ata/brcm-sata.txt
```
* Broadcom SATA3 AHCI Controller

SATA nodes are defined to describe on-chip Serial ATA controllers.
Each SATA controller should have its own node.

Required properties:
- compatible         : compatible list, contains "brcm,sata3-ahci"
- reg                : <registers mapping>
- interrupts         : <interrupt mapping for SATA IRQ>
- phy-generation     : 16-bit integer which describes both the SATA PHY design
		       generation, and revision number.
		       (0xXXYY, XX = generation, YY = rev)
- phy-base-addr      : Address of SATA PHY configuration registers.
- top-ctrl-base-addr : Address of the SATA IP core "top" registers.

Optional properties:
- phy-enable-ssc-mask : A 32-bit bitmask, where each bit is associated with
			one SATA port.
			(e.g.: If bit is 1, spread-spectrum clocking will be
			configured for that port.)
- phy-force-spd       : An array of integer pairs which specify the SATA port
			number and SATA speed generation to use as an
			upper-bound during link speed negotiation.

Example:
	sata@f045a000 {
		compatible = "brcm,sata3-ahci";
		reg = <0xf045a000 0x1000>;
		interrupts = <0x0 0x1e 0x0>;
		phy-generation = <0x2800>;
		phy-base-addr = <0xf0458100>;
		phy-enable-ssc-mask = <0x00000001>;
		phy-force-spd = <0 3
				 1 1>;
		top-ctrl-base-addr = <0xf0458040>;
	};
```

## linux/Documentation/devicetree/bindings/brcmstb/pm.txt
```
** Broadcom STB Power Management

Broadcom STB power management involves several hardware components which are
documented here.

* Always-On control block (AON CTRL)

This hardware provides control registers for the "always-on" (even in low-power
modes) hardware, such as the Power Management State Machine (PMSM).

Required properties:
- compatible     : should contain "brcm,brcmstb-aon-ctrl"
- reg            : the register start and length for the AON CTRL block

Example:

aon-ctrl@f0410000 {
	compatible = "brcm,brcmstb-aon-ctrl";
	reg = <0xf0410000 0x400>;
};

* DDR PHY control

Control registers for the DDR PHY(s) present on the SoC.

Required properties:
- compatible     : should contain "brcm,brcmstb-ddr-phy-v225.1"
- reg            : the register start and length pair(s) for the DDR PHY
		   control block(s), with each block being listed in index
                   order (i.e., DDR-0, DDR-1, etc.)

Example:

ddr-phy {
	compatible = "brcm,brcmstb-ddr-phy-v225.1";
	reg = <0xf1106000 0x24c
	       0xf1186000 0x24c
	       0xf1206000 0x24c>;
};
```

## linux/Documentation/devicetree/bindings/brcmstb/regsave.txt
```
* Broadcom Register Save/Restore Mechanism

Broadcom leverages the syscon functionality [1] to save and restore register
sets during PM operations.  Examples of such register sets are pinmux registers,
memc registers, etc.  Each register set to be saved/restored is described by a
syscon node which is defined in [1], for example:

	sun_top_ctrl: syscon@f0404000 {
		compatible = "brcm,brcmstb-sun-top-ctrl",
			"syscon";
		reg = <0xf0404000 0x51c>;
	};

There may be several of these syscons nodes defined.  If syscon nodes are used,
the device tree must define an 's3' node as follows:

Required properties:
- syscon-refs: a phandle list that refers to all of the defined syscon nodes.

Example:
	s3 {
		syscon-refs = <&sun_top_ctrl_pin_mux_ctrl>,
			<&sun_top_ctrl_pin_mux_pad_ctrl>,
			<&aon_pin_ctrl_pin_mux_ctrl>,
			<&aon_pin_ctrl_pad_mux_ctrl>,
			<&memc_arb_0_client_info>,
			<&memc_arb_1_client_info>,
			<&memc_arb_2_client_info>;
	};


1. linux/Documentation/devicetree/bindings/mfd/syscon.txt
```

## linux/Documentation/devicetree/bindings/clock/brcmstb-clock.txt
```
Device Tree Clock bindings for brcmstb

In addition to the platform bindings provided in-tree, the brcmstb common
clock driver supports the following clock providers/consumers:

	- CPU clock dividers (provider/consumer)

=== CPU clock divider ===

The CPU divider node serves as the sole clock for the CPU complex. It supports
power-of-2 clock division, with a divider of "1" as the default highest-speed
setting.

Required properties:
- compatible : shall be one of the following:
	"brcm,brcmstb-cpu-clk-div"
- reg : address and width of the divider configuration register
- #clock-cells : shall be set to 0
- clocks : phandle of clock provider which provides the source clock
	   (this would typically be a "fixed-clock" type PLL)
- div-table : list of (raw_value,divider) ordered pairs that correspond to the
	      allowed clock divider settings
- div-shift-width : least-significant bit position and width of divider value

example:
	cpupll: cpupll@0 {
		compatible = "fixed-clock";
		#clock-cells = <0>;
		clock-frequency = <1500000000>;
	};

	cpuclk: cpu-clk-div@0 {
		compatible = "brcm,brcmstb-cpu-clk-div";
		reg = <0xf03e257c 0x4>;
		#clock-cells = <0>;
		clocks = <&cpupll>;
		div-table = <0x00 1 0x11 2 0x12 4 0x13 8 0x14 16>;
		div-shift-width = <0 5>;
	};

	cpus {
		cpu@0 {
			clocks = <&cpuclk>;
		};
	};
```

## linux/Documentation/devicetree/bindings/dma/brcm-cma.txt
```
* Broadcom STB CMA Platform Device

The Broadcom STB CMA Platform Device is a character device intended for
providing a user-space interface to the dma-contiguous (CMA) API. More
specifically, this implementation allows for allocation of contiguous physical
memory on a particular memory controller (MEMC) within an STB SoC.

Required properties:
- compatible              : compatible list, contains "brcm,cma-plat-dev"
- linux,contiguous-region : A phandle to a memory/region node, as defined
                            in the CMA 'memory.txt' binding.

Example:
	/* snip */

	/* This node is defined per binding in 'memory.txt' */
	memory {
		#address-cells = <1>;
		#size-cells = <1>;
		device_type = "memory";
		reg = <0x0 0x40000000>;
		region_0: region@30000000 {
			contiguous-region;
			reg = <0x30000000 0x10000000>;
		};
	};

	/* snip */

	/*
	 * This node instantiates a CMA device, using the region with name
	 * 'region_0' as its range.
	 */
	cma-dev@0 {
		#address-cells = <0>;
		#size-cells = <0>;
		compatible = "brcm,cma-plat-dev";
		linux,contiguous-region = <&region_0>;
	};
```

## linux/Documentation/devicetree/bindings/mtd/brcmstb_nand.txt
```
* Broadcom STB NAND Controller

The Broadcom STB NAND controller utilizes the MTD subsystem to provide generic
access to NAND flash chips.

Required properties:
- compatible     : should contain "brcm,brcmnand" and an appropriate version
                   compatibility string, like "brcm,brcmnand-v7.0"
- reg            : the register start and length for NAND and (optionally, see
                  'flash-dma' property) FLASH_DMA blocks
- interrupts     : The HIF interrupt, for both NAND CTLRDY and FLASH_DMA_DONE
- #address-cells : <1> - subnodes give the chip-select number
- #size-cells    : <0>

Optional properties:
- flash-dma      : boolean, indicating controller support for FLASH_DMA; if set,
		   then the appropriate register range must be included in the
                   reg property

Each controller (compatible: "brcm,brcmnand") may contain one or more subnodes
to represent enabled chip-selects which (may) contain NAND flash chips. Their
properties are as follows.

Required properties:
- compatible        : should contain "brcm,nandcs"
- reg               : a single integer representing the chip-select number
                      (e.g., 0, 1, 2, etc.)
- #address-cells    : see partition.txt
- #size-cells       : see partition.txt

Optional properties:
- nand-on-flash-bbt : boolean, to enable the on-flash BBT for this chip-select

Each nandcs device node may optionally contain sub-nodes describing the flash
partition mapping. See partition.txt for more detail.

Example:

nand@f0442800 {
	compatible = "brcm,brcmnand-v7.0", "brcm,brcmnand";
	reg = <0xF0442800 0x600>,
	      <0xF0443000 0x100>;
	interrupts = <0 32 0>;
	flash-dma;

	#address-cells = <1>;
	#size-cells = <0>;

	nandcs@1 {
		compatible = "brcm,nandcs";
		reg = <1>; // Chip select 1
		nand-on-flash-bbt;

		// Partitions
		#address-cells = <1>;  // <2>, for 64-bit offset
		#size-cells = <1>;     // <2>, for 64-bit length
		flash0.rootfs@0 {
			reg = <0 0x10000000>;
		};
		flash0@0 {
			reg = <0 0>; // MTDPART_SIZ_FULL
		};
		flash0.kernel@10000000 {
			reg = <0x10000000 0x400000>;
		};
	};
};
```
